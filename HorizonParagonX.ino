

/* Fitness-Device-Definitions
 * ==========================
 * Fitness Machine Service:    0x1826
 * Treadmill Data Char:        0x2ACD (Mandatory)
 * FitnessMachine Status Char: 0x2ADA (Optional)
 * Training Status Char:       0x2AD3 (Optional)
 */
/* Paragon X -- Configuration
 * ==========================
 * Unknown Service              0xFFF0
 * Unknown Char:                0xFFF3
 * Unknown Char:                0xFFF4
 */

#include <bluefruit.h>
#include <Bounce2.h>
#include <Adafruit_GFX.h>
#include <Adafruit_SSD1306.h>

#define OLED_RESET 4 // not used / nicht genutzt bei diesem Display
Adafruit_SSD1306 display(OLED_RESET);

const int BTN00 = A0;
const int BTN01 = A1;
const int BTN02 = 27;
const int BTN03 = A4;
const int BTN04 = A3;
const int BTN05 = A5;

const int iInfoDuration = 1000;

Bounce debounced_00 = Bounce();
Bounce debounced_01 = Bounce();
Bounce debounced_02 = Bounce();
Bounce debounced_03 = Bounce();
Bounce debounced_04 = Bounce();
Bounce debounced_05 = Bounce();
unsigned long ulMillis = 0;
String sCurrentSpeed = "0.00";
String sCurrentDistance = " 0.00";
String sCurrentIncline = "0.00";
String sCurrentRuntime = "0:00:00";

String sDisplayMessage1 = "";
String sDisplayMessage2 = "";

// Speichern der User Defaults --> START/STOPP Speed/incline
int iUserVal[5][2] = { {2,0}, {52,0}, {72,0}, {77,0}, {92,0} };

#define arrlength(array) ((sizeof(array)) / (sizeof(array[0])))

///////////////// SAVING ////////////////////////////////////////////////////
#include <Adafruit_LittleFS.h>
#include <InternalFileSystem.h>
#include <Adafruit_TinyUSB.h> // for Serial

using namespace Adafruit_LittleFS_Namespace;

#define FILENAME    "/ParagonX.txt"
#define CONTENTS    "2,0;52,0;72,0;77,0;92,0;"

File file(InternalFS);
//////////////////////////////////////////////////////////////////////////////
// OTA DFU service
BLEDfu bledfu;

// Peripheral uart service
BLEUart bleuart;

// Central uart client
BLEClientUart clientUart;
//////////////////////////////////////////////////////////////////////////////
String inputString = "";         // a String to hold incoming data
bool stringComplete = false;  // whether the string is complete
bool bINITIALISIERT = false;  // Wird true, wenn verbunden mit Laufband

BLEClientService        FitnessMachineService(UUID16_SVC_FITNESS_MACHINE);
BLEClientCharacteristic TreadillDataCharacteristic(UUID16_CHR_TREADMILL_DATA);
BLEClientCharacteristic FitnessMachineStatusCharacteristic(UUID16_CHR_FITNESS_MACHINE_STATUS);

BLEClientService        TreadillControlService(0xFFF0);
BLEClientCharacteristic TreadillControl(0xFFF3); // FFF4 == Senden der Daten an diese Adresse
BLEClientCharacteristic TreadillControlNotify(0xFFF4);

const char cINIT[] = { 0x55, 0xaa, 0x00, 0x00, 0x02, 0x20, 0x00, 0x00, 0x00, 0x00, 0x0d, 0x0a };
const char cSTOPP[][12] = { { 0x55, 0xaa, 0x00, 0x00, 0x02, 0x14, 0x00, 0x00, 0x00, 0x00, 0x0d, 0x0a }, { 0x55, 0xaa, 0x00, 0x00, 0x03, 0x03, 0x00, 0x00, 0x00, 0x00, 0x0d, 0x0a } };
const char cENDE[]        = { 0x55, 0xaa, 0x00, 0x00, 0x02, 0x14, 0x00, 0x00, 0x00, 0x00, 0x0d, 0x0a };
const char cPAUSE[]       = { 0x55, 0xaa, 0x00, 0x00, 0x03, 0x03, 0x00, 0x00, 0x00, 0x00, 0x0d, 0x0a };
const char cSTART_053_015[] = { 0x55, 0xaa, 0x00, 0x00, 0x03, 0x02, 0x0e, 0x00, 0x42, 0xef, 0x00, 0x00, 0x00, 0x00, 0x00, 0x00, 0x00, 0x00, 0x01, 0x35, 0x00, 0x0f, 0x00, 0x00, 0x0d, 0x0a };
const char cSTART_030_120[] = { 0x55, 0xaa, 0x00, 0x00, 0x03, 0x02, 0x0e, 0x00, 0x91, 0x56, 0x00, 0x00, 0x00, 0x00, 0x00, 0x00, 0x00, 0x00, 0x01, 0x1e, 0x00, 0x78, 0x00, 0x00, 0x0d, 0x0a };
const char cSTART_060_000[] = { 0x55, 0xaa, 0x00, 0x00, 0x03, 0x02, 0x0e, 0x00, 0x0f, 0x6b, 0x00, 0x00, 0x00, 0x00, 0x00, 0x00, 0x00, 0x00, 0x01, 0x3c, 0x00, 0x00, 0x00, 0x00, 0x0d, 0x0a };
const char cSTART_075_000[] = { 0x55, 0xaa, 0x00, 0x00, 0x03, 0x02, 0x0e, 0x00, 0x5d, 0x11, 0x00, 0x00, 0x00, 0x00, 0x00, 0x00, 0x00, 0x00, 0x01, 0x4b, 0x00, 0x00, 0x00, 0x00, 0x0d, 0x0a };
const char cSTART_080_000[] = { 0x55, 0xaa, 0x00, 0x00, 0x03, 0x02, 0x0e, 0x00, 0xf8, 0xf9, 0x00, 0x00, 0x00, 0x00, 0x00, 0x00, 0x00, 0x00, 0x01, 0x50, 0x00, 0x00, 0x00, 0x00, 0x0d, 0x0a };
const char cSTART_081_000[] = { 0x55, 0xaa, 0x00, 0x00, 0x03, 0x02, 0x0e, 0x00, 0xa9, 0x53, 0x00, 0x00, 0x00, 0x00, 0x00, 0x00, 0x00, 0x00, 0x01, 0x51, 0x00, 0x00, 0x00, 0x00, 0x0d, 0x0a };
const char cSTART_085_000[] = { 0x55, 0xaa, 0x00, 0x00, 0x03, 0x02, 0x0e, 0x00, 0xaf, 0xda, 0x00, 0x00, 0x00, 0x00, 0x00, 0x00, 0x00, 0x00, 0x01, 0x55, 0x00, 0x00, 0x00, 0x00, 0x0d, 0x0a };
const char cSTART_100_000[] = { 0x55, 0xaa, 0x00, 0x00, 0x03, 0x02, 0x0e, 0x00, 0x10, 0x7c, 0x00, 0x00, 0x00, 0x00, 0x00, 0x00, 0x00, 0x00, 0x01, 0x64, 0x00, 0x00, 0x00, 0x00, 0x0d, 0x0a };
const char cSTART_120_000[] = { 0x55, 0xaa, 0x00, 0x00, 0x03, 0x02, 0x0e, 0x00, 0x61, 0xf3, 0x00, 0x00, 0x00, 0x00, 0x00, 0x00, 0x00, 0x00, 0x01, 0x78, 0x00, 0x00, 0x00, 0x00, 0x0d, 0x0a };

const String cSTART_TEXT[9] = { { "5.3 km/h + 1.5 %"}, { "3.0 km/h + 12.0 %"}, { "6.0 km/h + 0.0 %"}, { "7.5 km/h + 0.0 %"}, { "8.0 km/h + 0.0 %"}, 
                              { "8.1 km/h + 0.0 %"}, { "8.5 km/h + 0.0 %"},{ "10.0 km/h + 0.0 %"}, { "12.0 km/h + 0.0 %"} }; 
const char cSTART[][26] = { { 0x55, 0xaa, 0x00, 0x00, 0x03, 0x02, 0x0e, 0x00, 0x42, 0xef, 0x00, 0x00, 0x00, 0x00, 0x00, 0x00, 0x00, 0x00, 0x01, 0x35, 0x00, 0x0f, 0x00, 0x00, 0x0d, 0x0a },
                            { 0x55, 0xaa, 0x00, 0x00, 0x03, 0x02, 0x0e, 0x00, 0x91, 0x56, 0x00, 0x00, 0x00, 0x00, 0x00, 0x00, 0x00, 0x00, 0x01, 0x1e, 0x00, 0x78, 0x00, 0x00, 0x0d, 0x0a },
                            { 0x55, 0xaa, 0x00, 0x00, 0x03, 0x02, 0x0e, 0x00, 0x0f, 0x6b, 0x00, 0x00, 0x00, 0x00, 0x00, 0x00, 0x00, 0x00, 0x01, 0x3c, 0x00, 0x00, 0x00, 0x00, 0x0d, 0x0a },
                            { 0x55, 0xaa, 0x00, 0x00, 0x03, 0x02, 0x0e, 0x00, 0x5d, 0x11, 0x00, 0x00, 0x00, 0x00, 0x00, 0x00, 0x00, 0x00, 0x01, 0x4b, 0x00, 0x00, 0x00, 0x00, 0x0d, 0x0a },
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                            { 0x55, 0xaa, 0x00, 0x00, 0x03, 0x02, 0x0e, 0x00, 0x61, 0xf3, 0x00, 0x00, 0x00, 0x00, 0x00, 0x00, 0x00, 0x00, 0x01, 0x78, 0x00, 0x00, 0x00, 0x00, 0x0d, 0x0a } };

const char cSPEED[][15] = { { 0x55, 0xaa, 0x00, 0x00, 0x03, 0x05, 0x03, 0x00, 0x1c, 0x75, 0x08, 0x00, 0x01, 0x0d, 0x0a }, //  0,8 km/h
                            { 0x55, 0xaa, 0x00, 0x00, 0x03, 0x05, 0x03, 0x00, 0x2c, 0x42, 0x09, 0x00, 0x01, 0x0d, 0x0a }, //  0,9 km/h
                            { 0x55, 0xaa, 0x00, 0x00, 0x03, 0x05, 0x03, 0x00, 0x7c, 0x1b, 0x0a, 0x00, 0x01, 0x0d, 0x0a }, //  1,0 km/h
                            { 0x55, 0xaa, 0x00, 0x00, 0x03, 0x05, 0x03, 0x00, 0x4c, 0x2c, 0x0b, 0x00, 0x01, 0x0d, 0x0a }, //  1,1 km/h
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                            { 0x55, 0xaa, 0x00, 0x00, 0x03, 0x05, 0x03, 0x00, 0xeb, 0x53, 0xc8, 0x00, 0x01, 0x0d, 0x0a }};// 20,0 km/h

const char cINCLINE[][14] = { { 0x55, 0xaa, 0x00, 0x00, 0x03, 0x06, 0x02, 0x00, 0x0f, 0x1d, 0x00, 0x00, 0x0d, 0x0a }, // 0.0 %
                              { 0x55, 0xaa, 0x00, 0x00, 0x03, 0x06, 0x02, 0x00, 0xfa, 0xe2, 0x05, 0x00, 0x0d, 0x0a },  // 0.5 %
                              { 0x55, 0xaa, 0x00, 0x00, 0x03, 0x06, 0x02, 0x00, 0xc4, 0xf2, 0x0a, 0x00, 0x0d, 0x0a },
                              { 0x55, 0xaa, 0x00, 0x00, 0x03, 0x06, 0x02, 0x00, 0x31, 0x0d, 0x0f, 0x00, 0x0d, 0x0a },
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                              { 0x55, 0xaa, 0x00, 0x00, 0x03, 0x06, 0x02, 0x00, 0xff, 0x9c, 0x78, 0x00, 0x0d, 0x0a } };  // 12.0 %


void ButtonSetup()
{
  debounced_00.attach(BTN00, INPUT_PULLUP);
  debounced_00.interval(25);
  debounced_01.attach(BTN01, INPUT_PULLUP);
  debounced_01.interval(25);
  debounced_02.attach(BTN02, INPUT_PULLUP);
  debounced_02.interval(25);
  debounced_03.attach(BTN03, INPUT_PULLUP);
  debounced_03.interval(25);
  debounced_04.attach(BTN04, INPUT_PULLUP);
  debounced_04.interval(25);
  debounced_05.attach(BTN05, INPUT_PULLUP);
  debounced_05.interval(25);
}

void CheckButtonPressed()
{
  debounced_00.update();
  debounced_01.update();
  debounced_02.update();
  debounced_03.update();
  debounced_04.update();
  debounced_05.update();

  if ( debounced_00.fell() )
  {
    ulMillis = millis();
    if (bINITIALISIERT)
    {
      Serial.print("BUTTON: Start Treadmill: "); Serial.println(iUserVal[0][0]);
      // TreadillControl.write(cINIT, arrlength(cINIT));
      // delay (50);
      TreadillControl.write(cSTART[iUserVal[0][0]], arrlength(cSTART[iUserVal[0][0]]));
    } else {
      Serial.println("BUTTON: Start Treadmill : DEFAULT-SPEED - NOT CONNECTED!");
    }
    sDisplayMessage1 = "START";
    sDisplayMessage2 = cSTART_TEXT[iUserVal[0][0]];
  }
 if ( debounced_01.fell() )
  {
    ulMillis = millis();
    if (bINITIALISIERT)
    {
      Serial.print("BUTTON: STOP/PAUSE : "); Serial.println(iUserVal[0][1]);
      TreadillControl.write(cSTOPP[iUserVal[0][1]], arrlength(cSTOPP[iUserVal[0][1]]));
    } else {
      Serial.println("BUTTON: STOP/PAUSE - NOT CONNECTED!");
    }
    sDisplayMessage1 = "STOP";
    if (iUserVal[0][1] == 0)
    {
      sDisplayMessage2 = "- STOP -";
    } else {
      sDisplayMessage2 = "- PAUSE -";
    }
  }
 if ( debounced_02.fell() )
  { 
    ulMillis = millis();
    if (bINITIALISIERT)
    {
      Serial.print("BUTTON: USER1 : Speed="); Serial.print(float(iUserVal[1][0] + 8)/10); Serial.print(" km/h; Incline="); Serial.print((float)iUserVal[1][1]*5/10); Serial.println(" %");
      TreadillControl.write(cSPEED[iUserVal[1][0]], arrlength(cSPEED[iUserVal[1][0]]));
      TreadillControl.write(cINCLINE[iUserVal[1][1]], arrlength(cINCLINE[iUserVal[1][1]]));
    } else {
      Serial.println("BUTTON: USER1 - NOT CONNECTED!");
    }
    sDisplayMessage1 = "USER1";
    sDisplayMessage2 = String(float(iUserVal[1][0] + 8)/10) + " km/h + " + String((float)iUserVal[1][1]*5/10) + " %";
  }
 if ( debounced_03.fell() )
  {
    ulMillis = millis();
    if (bINITIALISIERT)
    {
      Serial.print("BUTTON: USER2 : Speed="); Serial.print(float(iUserVal[2][0] + 8)/10); Serial.print(" km/h; Incline="); Serial.print((float)iUserVal[2][1]*5/10); Serial.println(" %");
      TreadillControl.write(cSPEED[iUserVal[2][0]], arrlength(cSPEED[iUserVal[2][0]]));
      TreadillControl.write(cINCLINE[iUserVal[2][1]], arrlength(cINCLINE[iUserVal[2][1]]));
    } else {
      Serial.println("BUTTON: USER2 - NOT CONNECTED!");
    }
    sDisplayMessage1 = "USER2";
    sDisplayMessage2 = String(float(iUserVal[2][0] + 8)/10) + " km/h + " + String((float)iUserVal[2][1]*5/10) + " %";
  }
 if ( debounced_04.fell() )
  {
    ulMillis = millis();
    if (bINITIALISIERT)
    {
      Serial.print("BUTTON: USER3 : Speed="); Serial.print(float(iUserVal[3][0] + 8)/10); Serial.print(" km/h; Incline="); Serial.print((float)iUserVal[3][1]*5/10); Serial.println(" %");
      TreadillControl.write(cSPEED[iUserVal[3][0]], arrlength(cSPEED[iUserVal[3][0]]));
      TreadillControl.write(cINCLINE[iUserVal[3][1]], arrlength(cINCLINE[iUserVal[3][1]]));
    } else {
      Serial.println("BUTTON: USER3 - NOT CONNECTED!");
    }
    sDisplayMessage1 = "USER3";
    sDisplayMessage2 = String(float(iUserVal[3][0] + 8)/10) + " km/h + " + String((float)iUserVal[3][1]*5/10) + " %";
  }
 if ( debounced_05.fell() )
  {
    ulMillis = millis();
    if (bINITIALISIERT)
    {
      Serial.print("BUTTON: USER4 : Speed="); Serial.print(float(iUserVal[4][0] + 8)/10); Serial.print(" km/h; Incline="); Serial.print((float)iUserVal[4][1]*5/10); Serial.println(" %");
      TreadillControl.write(cSPEED[iUserVal[4][0]], arrlength(cSPEED[iUserVal[4][0]]));
      TreadillControl.write(cINCLINE[iUserVal[4][1]], arrlength(cINCLINE[iUserVal[4][1]]));
    } else {
      Serial.println("BUTTON: USER4 - NOT CONNECTED!");
    }
    sDisplayMessage1 = "USER4";
    sDisplayMessage2 = String(float(iUserVal[4][0] + 8)/10) + " km/h + " + String((float)iUserVal[4][1]*5/10) + " %";
  }
}



void initArduinoSpeicher()
{
  // Initialize Internal File System
  InternalFS.begin();
  
  file.open(FILENAME, FILE_O_READ);

  // file existed
  if ( file )
  {
    // Serial.println(FILENAME " file exists");
    
    uint32_t readlen;
    char buffer[64] = { 0 };
    readlen = file.read(buffer, sizeof(buffer));

    buffer[readlen] = 0;
    // Serial.print("Inhalt: ");
    // Serial.println(buffer);
    file.close();
    DecodeString(buffer);
  }else
  {
    Serial.print("Open " FILENAME " file to write ... ");

    if( file.open(FILENAME, FILE_O_WRITE) ) 
    {
      Serial.print("Writing: ");
      Serial.println(CONTENTS);
      Serial.println("OK");
      file.write(CONTENTS, strlen(CONTENTS));
      file.close();
    }else
    {
      Serial.println("Failed!");
    }
  }
}

void SchreibeUserdataPermanent()
{
  InternalFS.format();
  String inputString = "";
  inputString += String(iUserVal[0][0]) + "," + String(iUserVal[0][1]) + ";";
  inputString += String(iUserVal[1][0]) + "," + String(iUserVal[1][1]) + ";";
  inputString += String(iUserVal[2][0]) + "," + String(iUserVal[2][1]) + ";";
  inputString += String(iUserVal[3][0]) + "," + String(iUserVal[3][1]) + ";";
  inputString += String(iUserVal[4][0]) + "," + String(iUserVal[4][1]) + ";";
  
  if( file.open(FILENAME, FILE_O_WRITE) )
  {
    Serial.print("WritingUserdataPermanent: ");
    Serial.println(inputString);
    file.seek(0);
    file.write(inputString.c_str(), strlen(inputString.c_str()));
    file.close();
  }else
  {
    Serial.println("WritingUserdataPermanent: Failed!");
  }
}


void DecodeString(String sSource)
{
  int iPos = -1;
  int iCounter = 0;
  int iStrBegin = 0;
  int iKomma = -1;
  String sIntern = sSource;

  Serial.print("DecodeString = "); Serial.println(sSource);
  
  iPos = sSource.substring(iStrBegin).indexOf(";");
  
  while (iPos != -1)
  {
    sIntern = sSource.substring(0, iPos);
    sSource = sSource.substring(iPos + 1);
    iKomma = sIntern.indexOf(",");
    iUserVal[iCounter][0] = sIntern.substring(0, iKomma).toInt();
    iUserVal[iCounter][1] = sIntern.substring(iKomma +1).toInt();
    
    // Serial.print("DecodeString = "); Serial.print(sIntern); Serial.print(" ["); Serial.print(iPos); Serial.println("]");
    iPos = sSource.indexOf(";");
    iCounter++;
  }
}



void printCharHEX(const char* c, size_t sLen)
{
  Serial.print("printCharHEX = "); 
  for (int i = 0; i < sLen; i++)
  {
    if (i > 0) { Serial.print("-"); }
    if (c[i]<0x10) { Serial.print("0"); } 
    Serial.print(c[i], HEX);
  }
  Serial.println("");
}

void printCharINT(const char* c, size_t sLen)
{
  Serial.print("printCharINT = "); 
  for (int i = 0; i < sLen; i++)
  {
    if (i > 0) { Serial.print("-"); }
    Serial.print((int)c[i]);
  }
  Serial.println("");
}

void startAdv(void)
{
  // Advertising packet
  Bluefruit.Advertising.addFlags(BLE_GAP_ADV_FLAGS_LE_ONLY_GENERAL_DISC_MODE);
  Bluefruit.Advertising.addTxPower();

  // Include bleuart 128-bit uuid
  Bluefruit.Advertising.addService(bleuart);

  // Secondary Scan Response packet (optional)
  // Since there is no room for 'Name' in Advertising packet
  Bluefruit.ScanResponse.addName();

  /* Start Advertising
   * - Enable auto advertising if disconnected
   * - Interval:  fast mode = 20 ms, slow mode = 152.5 ms
   * - Timeout for fast mode is 30 seconds
   * - Start(timeout) with timeout = 0 will advertise forever (until connected)
   *
   * For recommended advertising interval
   * https://developer.apple.com/library/content/qa/qa1931/_index.html
   */
  Bluefruit.Advertising.restartOnDisconnect(true);
  Bluefruit.Advertising.setInterval(32, 244);    // in unit of 0.625 ms
  Bluefruit.Advertising.setFastTimeout(30);      // number of seconds in fast mode
  Bluefruit.Advertising.start(0);                // 0 = Don't stop advertising after n seconds
}

/*------------------------------------------------------------------*/
/* Peripheral
 *------------------------------------------------------------------*/
void prph_connect_callback(uint16_t conn_handle)
{
  // Get the reference to current connection
  BLEConnection* connection = Bluefruit.Connection(conn_handle);

  char peer_name[32] = { 0 };
  connection->getPeerName(peer_name, sizeof(peer_name));

  Serial.print("[Prph] Connected to ");
  Serial.println(peer_name);
}

void prph_disconnect_callback(uint16_t conn_handle, uint8_t reason)
{
  (void) conn_handle;
  (void) reason;

  Serial.println();
  Serial.println("[Prph] Disconnected");
}

void SetzeUserSpeed(String sUserS)
{
  int iUser = sUserS.substring(0,1).toInt();
  int iUserPos = 1;
  if (iUser < 1) { iUserPos = 1; }
  if (iUser > 4) { iUserPos = 4; }
  float dSpeed = sUserS.substring(1).toFloat();
  int iPos = (int) (dSpeed * 10) - 8;
  if (iPos < 0) { iPos = 0; }
  if (iPos > 192) { iPos = 192; }
  Serial.print("SetUserSpeed = ["); Serial.print((String)iUser); Serial.print("] "); Serial.print(iUserPos); Serial.print(" >> "); Serial.print(dSpeed); Serial.print(" ==> "); Serial.println(float(iPos + 8)/10);
  iUserVal[iUserPos][0] = iPos;

  SchreibeUserdataPermanent();
}

void SetzeUserIncline(String sUserI)
{
  int iUser = sUserI.substring(0,1).toInt();
  int iUserPos = 1;
  if (iUser < 1) { iUserPos = 1; }
  if (iUser > 4) { iUserPos = 4; }
  
  // iUserVal[5][2] = { {2,0}, {52,0}, {72,0}, {77,0}, {92,0} };
  
  float dIncline = sUserI.substring(1).toFloat();
  int iPos = (int) (dIncline*2);
  if (iPos < 0) { iPos = 0; }
  if (iPos > 24) { iPos = 24; }
  
  Serial.print("SetUserIncline = ["); Serial.print((String)iUser); Serial.print("] "); Serial.print(iUserPos); Serial.print(" >> "); Serial.print(dIncline); Serial.print(" ==> "); Serial.println((float)iPos*5/10);
  iUserVal[iUserPos][1] = iPos;

  SchreibeUserdataPermanent();
}


void SetzeUserStart(String sUser)
{
  int iUser = sUser.substring(0).toInt();
  if (iUser < 0) { iUser = 0; }
  if (iUser > 8) { iUser = 8; }
  iUserVal[0][0] = iUser;
  SchreibeUserdataPermanent();
}

void SetzeUserEnd(String sUser)
{
  int iUser = sUser.substring(0).toInt();
  if (iUser < 0) { iUser = 0; }
  if (iUser > 1) { iUser = 1; }
  iUserVal[0][1] = iUser;
  SchreibeUserdataPermanent();
}

void prph_bleuart_rx_callback(uint16_t conn_handle)
{
  (void) conn_handle;
  
  // Forward data from Mobile to our peripheral
  char str[20+1] = { 0 };
  bleuart.read(str, 20);

  Serial.print("[Prph] RX: ");
  Serial.println(str);  

  String sValues(str);  
  
  if (sValues.substring(0,2) == "US")
  {
    // Serial.println("Setze US Speed");
    SetzeUserSpeed(sValues.substring(2));
  }
  if (sValues.substring(0,2) == "UI")
  {
    // Serial.println("Setze UI Incline");
    SetzeUserIncline(sValues.substring(2));
  }
  if (sValues.substring(0,2) == "UB")
  {
    SetzeUserStart(sValues.substring(2));
  }
  if (sValues.substring(0,2) == "UE")
  {
    SetzeUserEnd(sValues.substring(2));
  }
  if ( clientUart.discovered() )
  {
    clientUart.print(str);
  }else
  {
    bleuart.println("[Prph] Central role not connected");
  }
}
/**
 * Callback invoked when uart received data
 * @param cent_uart Reference object to the service where the data 
 * arrived. In this example it is clientUart
 */
void cent_bleuart_rx_callback(BLEClientUart& cent_uart)
{
  
  char str[20+1] = { 0 };
  cent_uart.read(str, 20);

  Serial.print("[Cent] RX: ");
  Serial.println(str);
  if ( bleuart.notifyEnabled() )
  {
    // Forward data from our peripheral to Mobile
    bleuart.print( str );
  }else
  {
    // response with no prph message
    clientUart.println("[Cent] Peripheral role not connected");
  }  
}

void updateDisplay()
{
  display.clearDisplay();

  // Serial.print("TEST: "); Serial.print(millis()); Serial.print(" = "); Serial.print(ulMillis); Serial.print(" >>> "); Serial.println((millis() - ulMillis));
  /*
  if ((millis() - ulMillis) > iInfoDuration)
  {
    sDisplayMessage = "";
    Serial.println("Reset Message...");
  }
  */
  if ( (sDisplayMessage1 != "") && ((millis() - ulMillis) < iInfoDuration))
  {
    display.setTextColor(WHITE);
    display.setTextSize(4);
    display.setCursor(1,0);
    display.println(sDisplayMessage1);
    display.setTextSize(1);
    display.setCursor(0,54);
    display.print(sDisplayMessage2);
    if (!bINITIALISIERT)
    {
      display.setTextSize(1);
      display.setCursor(0,38);
      display.print("NOT CONNECTED!");
    }
  } else { 
    // set text color / Textfarbe setzen
    display.setTextColor(WHITE);
    // set text size / Textgroesse setzen
    display.setTextSize(4);
    // set text cursor position / Textstartposition einstellen
    display.setCursor(0,0);
    // show text / Text anzeigen
    display.print(sCurrentDistance);
    display.setTextSize(1); 
    display.setCursor(122,4);
    display.print("k");
    display.setCursor(122,14); 
    display.print("m");
    
    display.setTextSize(2);
    display.setCursor(20,34);
    display.print(sCurrentRuntime);
    
    // display.print("63,89"); display.println("km");
    display.setCursor(0,54);
    display.setTextSize(1);
    // display.print("20,0"); display.print(" km/h - "); display.print("12.0"); display.println(" %");
    display.print(sCurrentSpeed); display.print(" km/h + "); display.print(sCurrentIncline); display.println(" %");
  }
  display.display();  
}

void setupDisplay()
{
  display.begin(SSD1306_SWITCHCAPVCC, 0x3C);
  updateDisplay();
}

void setup()
{
  bINITIALISIERT = false;  /// <<<<<<<<<<<<<<<<<<<<<<<<<<<<<<<<<<<<<<<<<<<<<<<<<<<< FALSE -- TRUE == DEBUG

  
  Serial.begin(115200);
  while ( !Serial ) delay(10);
  Serial.println("Start Horizon Paragon X - BLE Client");
  Serial.println("-----------------------------------------------");

  ButtonSetup();
  initArduinoSpeicher();

  setupDisplay();
  
  inputString.reserve(200);
  
  // Initialize Bluefruit with maximum connections as Peripheral = 0, Central = 1
  // SRAM usage required by SoftDevice will increase dramatically with number of connections
  Bluefruit.begin(1, 2);

  Bluefruit.setName("Arduino Fitness-Client");

  // FitnessMachineStatusCharacteristic.setNotifyCallback(FitnessMachineControlPoint_callback);
  FitnessMachineStatusCharacteristic.begin(&FitnessMachineService);
  
  TreadillDataCharacteristic.setNotifyCallback(FitnessData_notify_callback);
  TreadillDataCharacteristic.begin(&FitnessMachineService);

  TreadillControlNotify.setNotifyCallback(TreadmillControl_notify_callback);
  TreadillControlNotify.begin(&TreadillControlService);  
  
  TreadillControl.begin(&TreadillControlService);
  
  // Increase Blink rate to different from PrPh advertising mode
  Bluefruit.setConnLedInterval(250);
  

  // Callbacks for Central
  Bluefruit.Central.setDisconnectCallback(disconnect_callback);
  Bluefruit.Central.setConnectCallback(connect_callback);



///////////////////////////////////////////////////////////
  Bluefruit.setTxPower(4);    // Check bluefruit.h for supported values

  // Callbacks for Peripheral
  Bluefruit.Periph.setConnectCallback(prph_connect_callback);
  Bluefruit.Periph.setDisconnectCallback(prph_disconnect_callback);
  
  // To be consistent OTA DFU should be added first if it exists
  bledfu.begin();

  // Configure and Start BLE Uart Service
  bleuart.begin();
  bleuart.setRxCallback(prph_bleuart_rx_callback);

  // Init BLE Central Uart Serivce
  clientUart.begin();
  clientUart.setRxCallback(cent_bleuart_rx_callback);
///////////////////////////////////////////////////////////


  /* Start Central Scanning
   * - Enable auto scan if disconnected
   * - Interval = 100 ms, window = 80 ms
   * - Don't use active scan
   * - Filter only accept HRM service
   * - Start(timeout) with timeout = 0 will scan forever (until connected)
   */
  Bluefruit.Scanner.setRxCallback(scan_callback);
  Bluefruit.Scanner.restartOnDisconnect(true);
  Bluefruit.Scanner.setInterval(160, 80); // in unit of 0.625 ms
  // Bluefruit.Scanner.filterUuid(FitnessMachineService.uuid);
  // Serial.print("Filter = "); 
  // Serial.println(FitnessMachineService.uuid.toString());
  Bluefruit.Scanner.useActiveScan(false);
  Bluefruit.Scanner.start(0);                   // // 0 = Don't stop scanning after n seconds
///////////////////////////////////////////////////////////
  startAdv();
///////////////////////////////////////////////////////////
}

int StrToHex(char str[])
{
  return (int) strtol(str, 0, 16);
}


void SetzeSpeed(float dVal)
{
  int iPos = (int) (dVal * 10) - 8;
  if (iPos < 0) { iPos = 0; }
  if (iPos > 192) { iPos = 192; }
  Serial.print("SetSpeed ["); Serial.print(dVal); Serial.print("] : POS = "); Serial.print(iPos); Serial.print(" => "); Serial.print(float(iPos + 8)/10); Serial.println(" km/h");
  // printCharHEX(cSPEED[iPos], arrlength(cSPEED[iPos]));
  TreadillControl.write(cSPEED[iPos], arrlength(cSPEED[iPos]));
}

void SetzeIncline(float dVal)
{
  int iPos = (int) (dVal*2);
  if (iPos < 0) { iPos = 0; }
  if (iPos > 24) { iPos = 24; }
  Serial.print("SetIncline ["); Serial.print(dVal); Serial.print("] : POS = "); Serial.print(iPos); Serial.print(" == "); Serial.print((float)iPos*5/10); Serial.println(" %");
  
  //printCharHEX(cINCLINE[iPos], arrlength(cINCLINE[iPos]));
  TreadillControl.write(cINCLINE[iPos], arrlength(cINCLINE[iPos]));
}

void loop()
{
  CheckButtonPressed();
  if (bINITIALISIERT)
  {
    if (stringComplete) {
      // For DEBUGGING
      char cData[20];
      Serial.print("RECEIVED: "); Serial.println(inputString);
      
      // clear the string:
      inputString = "";
      stringComplete = false;
    }
  } else {
    // updateDisplay();
  }
  updateDisplay();
}

/**
 * Callback invoked when scanner pick up an advertising data
 * @param report Structural advertising data
 */
void scan_callback(ble_gap_evt_adv_report_t* report)
{
  // Since we configure the scanner with filterUuid()
  // Scan callback only invoked for device with hrm service advertised
  // Connect to device with HRM service in advertising
  
  // Serial.print("MAC = ");
  String sMAC = "";
  for (int i=5; i >= 0; i--)
  { 
    if (i < 5) { sMAC += ":"; }
    if (report->peer_addr.addr[i]<0x10) { sMAC += "0"; } 
    sMAC += String(report->peer_addr.addr[i], HEX); 
  }
  // RUNN = E1:78:3E:5B:7C:07
  // Serial.println(sMAC);
  String sCompare = "b0:b1:13:42:55:f1";
  if (sCompare == sMAC.substring(0,17))
  {
    Serial.println("CONNECTING with Paragon X");
    Bluefruit.Central.connect(report);
  } else {
    Bluefruit.Scanner.resume();
  }
}

/**
 * Callback invoked when an connection is established
 * @param conn_handle
 */
void connect_callback(uint16_t conn_handle)
{
  Serial.println("Connected");

  if ( !FitnessMachineService.discover(conn_handle) )
  {
    Serial.println("No Fitness-Machine found!");

    Bluefruit.disconnect(conn_handle);
    return;
  } else {
    Serial.println("Fitness-Machine found!");
  }

  Bluefruit.Connection(conn_handle)->requestMtuExchange(103); // send 103 - received 23?!
  
  if ( !TreadillControlService.discover(conn_handle) )
  {
    Serial.println("No TreadmillControl-Service found!");
  } else {
    Serial.println("TreadmillControl-Service found!");
  }
  
  if ( !TreadillDataCharacteristic.discover() )
  {
    Serial.println("Treadmill-Data Characteristic not found !!!");  
    // Bluefruit.disconnect(conn_handle);
    // Bluefruit.Scanner.resume();
    // return;
  } else {
    Serial.println("Treadmill-Data Characteristic found !");
  }

  if ( !TreadillControl.discover() )
  {
     Serial.println("Treadmill-Control not found!");
  } else {
    Serial.println("Treadmill-Control connected!");
  }
  

  if ( FitnessMachineStatusCharacteristic.discover() )
  {
    Serial.println("Fitness-Machine-Status found !");
   
    // Read 8-bit FitnessMachineStatusCharacteristic value from peripheral
    uint32_t loc_value = FitnessMachineStatusCharacteristic.read32();
    
    Serial.print("Fitness-Machine-Status: ");
    Serial.println(loc_value);
  }else
  {
    Serial.println("Fitness-Machine-Status NOT FOUND !!!");
  }
  

  if ( TreadillDataCharacteristic.enableNotify() )
  {
    Serial.println("Ready to receive Treadmill-Data !!!");
  }else
  {
    Serial.println("Treadmill-Data NOTIFY not activated!");
  }

  if (TreadillControlNotify.discover())
  {
    Serial.println("TreadmillControlNotify -> FOUND");
    if (TreadillControlNotify.enableNotify() )
    {
      Serial.println("Control Notify enabled!");
    } else {
      Serial.println("Control Notify NOT ENABLED!");
    }
  } else {
    Serial.println("TreadmillControlNotify -> NOT FOUND");
  }

  bINITIALISIERT = true;
}

/**
 * Callback invoked when a connection is dropped
 * @param conn_handle
 * @param reason is a BLE_HCI_STATUS_CODE which can be found in ble_hci.h
 */
void disconnect_callback(uint16_t conn_handle, uint8_t reason)
{
  (void) conn_handle;
  (void) reason;
  bINITIALISIERT = false;
  Serial.print("Getrennt, GRUND = 0x"); Serial.println(reason, HEX);
}

void TreadmillControl_notify_callback(BLEClientCharacteristic* chr, uint8_t* data, uint16_t len)
{
  Serial.println("TreadmillControlNotify Callback: (");
  uint8_t loc_value = chr->read8();
  Serial.print("CHR = "); Serial.print(loc_value); Serial.print(" + ");
  Serial.print(len); Serial.print(") == ");

  for (int i=0; i < len; i++)
  { 
    if (i > 0) { Serial.print("-"); }
    if (data[i]<0x10) { Serial.print("0"); } 
    Serial.print(data[i],HEX); 
  }
  Serial.println("");
}
/**
 * Hooked callback that triggered when a measurement value is sent from peripheral
 * @param chr   Pointer client characteristic that even occurred,
 *              in this example it should be TreadillDataCharacteristic
 * @param data  Pointer to received data
 * @param len   Length of received data
 */
int strToHex(char str[])
{
  return (int) strtol(str, 0, 16);
}
int iCounter = 0;
void FitnessData_notify_callback(BLEClientCharacteristic* chr, uint8_t* data, uint16_t len)
{
  // https://www.bluetooth.com/specifications/gatt/viewer?attributeXmlFile=org.bluetooth.characteristic.heart_rate_measurement.xml
  // Measurement contains of control byte0 and measurement (8 or 16 bit) + optional field
  // ????? if byte0's bit0 is 0 --> measurement is 8 bit, otherwise 16 bit.
  // Serial.println("CALLBACK...");
  int iTmp = 0;
  int iSekunden = 0;
  int iMinuten = 0;
  // Serial.println("CALLBACK");
  iCounter++;
  String sData((char*)data);
  if (len == 19)
  {
    int num = data[2] + data[3] * 256;
    String s = String(num/100) + "." + String(num%100);
    Serial.print("Daten = ");
    Serial.print(s);
    Serial.print("km/h, ");
    sCurrentSpeed = s;
    
    double dnum = (double)(data[4] + data[5] * 256)/1000;
    if ( ((int)dnum) < 10)
    {
      s = " " + String((int)dnum) + "." + String(int(dnum*10)%10) + String(int(dnum*100)%10);
    } else {
      s = String((int)dnum) + "." + String(int(dnum*10)%10) + String(int(dnum*100)%10);
    }
    Serial.print(s);
    Serial.print("km, ");
    sCurrentDistance = s;
    num = data[7];
    s = String(num/10) + "." + String(num%10);
    Serial.print(s);
    sCurrentIncline = s;
    Serial.print("%, ");
    num = data[17] + data[18] * 256;
    int iSek, iMin, iStd;
    iSek = num%60;
    iMin = (num/60)%60;
    iStd = (num/60)/60;

    s = "";
    if (iStd > 0) { s = String(iStd) + ":"; }
    if (iMin < 10) { s = s + "0" + String(iMin); } else { s = s + String(iMin); };
    if (iSek < 10) { s = s + ":0" + String(iSek); } else { s = s + ":" + String(iSek); };

    Serial.print(s);
    Serial.print ("min [");
    sCurrentRuntime = s;
      
    for (int i=0; i < len; i++)
    { 
      if (i > 0) { Serial.print("-"); }
      if (data[i]<0x10) { Serial.print("0"); } 
      Serial.print(data[i],HEX); 
    }
    Serial.println("]");
  } else {
    Serial.print("Len nicht passend! ("); Serial.print(len); Serial.println(")");
  }

  // updateDisplay();
}

void FitnessMachineControlPoint_callback(BLEClientCharacteristic* chr, uint8_t* data, uint16_t len)
{
  Serial.print("Fitness-MachineControl Callback");
  // Serial.print((char*)data);
  
  Serial.print(" == "); 
  for (int i=0; i < len; i++)
  { 
    if (i > 0) { Serial.print("-"); }
    if (data[i]<0x10) { Serial.print("0"); } 
    Serial.print(data[i],HEX); 
  }
  Serial.println("");
  /*
    Fitness Machine Control Point Procedure Requirements
    ====================================================
    Op Code Value  Requirement Definition  Parameter Value Description
    0x01  M Reset, see Section 4.16.2.2 N/A Initiates the procedure to reset the controllable settings of a fitness machine. The response to this control point is Op Code 0x80 followed by the appropriate Parameter Value.
    0x02  C.1 Set Target Speed, see Section 4.16.2.3  Target Speed, UINT16, in km/h with a resolution of 0.01 km/h  Initiate the procedure to set the target speed of the Server. The desired target speed is sent as parameters to this op code. The response to this control point is Op Code 0x80 followed by the appropriate Parameter Value.
    0x03  C.2 Set Target Inclination, see Section 4.16.2.4  Target Inclination, SINT16, in Percent with a resolution of 0.1 % Initiate the procedure to set the target inclination of the Server. The desired target inclination is sent as parameters to this op code. The response to this control point is Op Code 0x80 followed by the appropriate Parameter Value.
    0x04  C.3 Set Target Resistance Level, see Section 4.16.2.5 Target Resistance Level, UINT8, unitless with a resolution of 0.1.  Initiate the procedure to set the target resistance level of the Server. The desired target resistance level is sent as parameters to this op code. The response to this control point is Op Code 0x80 followed by the appropriate Parameter Value.
    0x05  C.4 Set Target Power, see Section 4.16.2.6  Target Power, SINT16, in Watt with a resolution of 1 W. Initiate the procedure to set the target power of the Server. The desired target power is sent as parameters to this op code. The response to this control point is Op Code 0x80 followed by the appropriate Parameter Value.
    0x06  C.5 Set Target Heart Rate, see Section 4.16.2.7 Target Heart Rate, UINT8, in BPM with a resolution of 1 BPM.  Initiate the procedure to set the target heart rate of the Server. The desired target heart rate is sent as parameters to this op code. The response to this control point is Op Code 0x80 followed by the appropriate Parameter Value.
    0x07  M Start or Resume, see Section 4.16.2.8 N/A Initiate the procedure to start or resume a training session on the Server. The response to this control point is Op Code 0x80 followed by the appropriate Parameter Value.
    0x08  M Stop or Pause, see Section 4.16.2.9 Control Information, see Section 4.16.2.9.  Initiate the procedure to stop or pause a training session on the Server. The response to this control point is Op Code 0x80 followed by the appropriate Parameter Value.
    0x09  C.6 Set Targeted Expended Energy, see Section 4.16.2.10 Targeted Expended Energy, UINT16, in Calories with a resolution of 1 Calorie. Set the targeted expended energy for a training session on the Server. The response to this control point is Op Code 0x80 followed by the appropriate Parameter Value.
    0x0A  C.7 Set Targeted Number of Steps, see Section 4.16.2.11 Targeted Number of Steps, UINT16, in Steps with a resolution of 1 Step. Set the targeted number of steps for a training session on the Server. The response to this control point is Op Code 0x80 followed by the appropriate Parameter Value.
    0x0B  C.8 Set Targeted Number of Strides, see Section 4.16.2.12 Targeted Number of Strides, UINT16, in Stride with a resolution of 1 Stride.  Set the targeted number of strides for a training session on the Server. The response to this control point is Op Code 0x80 followed by the appropriate Parameter Value.
    0x0C  C.9 Set Targeted Distance, see Section 4.16.2.13  Targeted Distance, UINT24, in Meters with a resolution of 1 Meter.  Set the targeted distance for a training session on the Server. The response to this control point is Op Code 0x80 followed by the appropriate Parameter Value.
    0x0D  C.10  Set Targeted Training Time, see Section 4.16.2.14 Targeted Training Time, UINT16, in Seconds with a resolution of 1 Second. Set the targeted training time for a training session on the Server. The response to this control point is Op Code 0x80 followed by the appropriate Parameter Value.
    0x0E  C.11  Set Targeted Time in Two Heart Rate Zones, see Section 4.16.2.15  Targeted Time Array, see Section 4.16.2.15. Set the targeted time in two heart rate zones for a training session on the Server. The response to this control point is Op Code 0x80 followed by the appropriate Parameter Value.
    0x0F  C.12  Set Targeted Time in Three Heart Rate Zones, see Section 4.16.2.16  Targeted Time Array, see Section 4.16.2.16. Set the targeted time in three heart rate zones for a training session on the Server. The response to this control point is Op Code 0x80 followed by the appropriate Parameter Value.
    0x10  C.13  Set Targeted Time in Five Heart Rate Zones, see Section 4.16.2.17 Targeted Time Array, see Section 4.16.2.17. Set the targeted time in five heart rate zones for a training session on the Server. The response to this control point is Op Code 0x80 followed by the appropriate Parameter Value.
    0x11  C.14  Set Indoor Bike Simulation Parameters, see Section 4.16.2.18  Simulation Parameter Array, see Section 4.16.2.18 Set the simulation parameters for a training session on the Server. The response to this control point is Op Code 0x80 followed by the appropriate Parameter Value.
    0x12  O Set Wheel Circumference, see Section 4.16.2.19  Wheel Circumference, UINT16, in Millimeters with resolution of 0.1 Millimeter Set the wheel circumference for a training session on the Server. The response to this control point is Op Code 0x80 followed by the appropriate Parameter Value.
    0x13  O Spin Down Control, see Section 4.16.2.20  Control Parameter, see Section 4.16.2.20  Control the spin down procedure of a Server. The response to this control point is Op Code 0x80 followed by the appropriate Parameter Value.
    0x14  C.15  Set Targeted Cadence  Targeted Cadence, UINT16, in 1/minute with a resolution of 0.5 1/minute.  Set the targeted cadence for a training session on the Server. The response to this control point is Op Code 0x80 followed by the appropriate Parameter Value.
    0x15-0x7F N/A Reserved for Future Use N/A N/A
    0x80  M Response Code, see Section 4.16.2.22  See Section 4.16.2.22 Used to identify the response to this Control Point.
    0x81-0xFF N/A Reserved for Future Use N/A N/A
    C.1: Mandatory to support if the Speed Target Setting feature is supported; otherwise Excluded.
    C.2: Mandatory to support if the Inclination Target Setting feature is supported; otherwise Excluded.
    C.3: Mandatory to support if the Resistance Target Setting feature is supported; otherwise Excluded.
    C.4: Mandatory to support if the Power Target Setting feature is supported; otherwise Excluded.
    C.5: Mandatory to support if the Heart Rate Target Setting feature is supported; otherwise Excluded.
    C.6: Mandatory to support if the Targeted Energy Expended Configuration feature is supported; otherwise Excluded.
    C.7: Mandatory to support if the Targeted Number of Steps Configuration feature is supported; otherwise Excluded.
    C.8: Mandatory to support if the Targeted Number of Strides Configuration feature is supported; otherwise Excluded.
    C.9: Mandatory to support if the Targeted Distance Configuration feature is supported; otherwise Excluded.
    C.10: Mandatory to support if the Targeted Training Time Configuration feature is supported; otherwise Excluded.
    C.11: Mandatory to support if the Targeted Time in Two Heart Rate Zones Configuration feature is supported; otherwise Excluded.
    C.12: Mandatory to support if the Targeted Time in Three Heart Rate Zones Configuration feature is supported; otherwise Excluded.
    C.13: Mandatory to support if the Targeted Time in Five Heart Rate Zones Configuration feature is supported; otherwise Excluded.
    C.14: Mandatory to support if the Indoor Bike Simulation Parameters feature is supported; otherwise Excluded.
    C.15: Mandatory to support if the Set Targeted Cadence feature is supported; otherwise Excluded.
   * 
   */
}

void FitnessMachineStatus_callback(BLEClientCharacteristic* chr, uint8_t* data, uint16_t len)
{
  Serial.print("Maschinen-Status Callback");
  
  Serial.print(" == "); 
  for (int i=0; i < len; i++)
  { 
    if (i > 0) { Serial.print("-"); }
    if (data[i]<0x10) { Serial.print("0"); } 
    Serial.print(data[i],HEX); 
  }
  Serial.println("");
  /*
    Op Code Definition  Parameter
    0x00  Reserved for Future Use N/A
    0x01  Reset N/A
    0x02  Fitness Machine Stopped or Paused by the User Control Information, see Table 4.16.
    0x03  Fitness Machine Stopped by Safety Key N/A
    0x04  Fitness Machine Started or Resumed by the User  N/A
    0x05  Target Speed Changed  New Target Value (UINT16 in kilometer per hour with a resolution 0.01 km/h)
    0x06  Target Incline Changed  New Target Value (SINT16 in % with a resolution of 0.1 %)
    0x07  Target Resistance Level Changed New Target Value (UINT8, unitless with a resolution of 0.1)
    0x08  Target Power Changed  New Target Power (SINT16, in Watt with a resolution of 1)
    0x09  Target Heart Rate Changed New Target Heart Rate (UINT8, in BPM with a resolution of 1)
    0x0A  Targeted Expended Energy Changed  New Targeted Expended Energy (UINT16, in Calories with a resolution of 1)
    0x0B  Targeted Number of Steps Changed  New Targeted Number of Steps Value (UINT16, in Steps with a resolution of 1)
    0x0C  Targeted Number of Strides Changed  New Targeted Number of Strides (UINT16, in Stride with a resolution of 1)
    0x0D  Targeted Distance Changed New Targeted Distance (UINT24, in Meters with a resolution of 1)
    0x0E  Targeted Training Time Changed  New Targeted Training Time (UINT16, in Seconds with a resolution of 1)
    0x0F  Targeted Time in Two Heart Rate Zones Changed New Targeted Time Array, see Section 4.16.2.15.
    0x10  Targeted Time in Three Heart Rate Zones Changed New Targeted Time Array, see Section 4.16.2.16.
    0x11  Targeted Time in Five Heart Rate Zones Changed  New Targeted Time Array, see Section 4.16.2.17.
    0x12  Indoor Bike Simulation Parameters Changed New Indoor Bike Simulation Parameters, see Section 4.16.2.18.
    0x13  Wheel Circumference Changed New Wheel Circumference (UINT16, in Millimeters with resolution of 0.1 Millimeter)
    0x14  Spin Down Status  Spin Down Status Value, see Table 4.27
    0x15  Targeted Cadence Changed  New Targeted Cadence (UINT16, in 1/minute with a resolution of 0.5)
    0x16 – 0xFE Reserved for Future Use N/A
    0xFF  Control Permission Lost N/A
    
    
    Spin Down Status Value (UINT8)  Definition
    0x00  Reserved for Future Use
    0x01  Spin Down Requested
    0x02  Success
    0x03  Error
    0x04  Stop Pedaling
    0x05 – 0xFF Reserved for Future Use
   */
}

void serialEvent() {
  while (Serial.available()) {
    // get the new byte:
    char inChar = (char)Serial.read();
    // add it to the inputString:
    
    // if the incoming character is a newline, set a flag so the main loop can
    // do something about it:
    if (inChar == '\n') {
      stringComplete = true;
    } else {
      inputString += inChar;
    }
  }
}
